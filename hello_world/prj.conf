## prj.conf
```kconfig
CONFIG_LOG=y
CONFIG_PARTITION_MANAGER_ENABLED=y
CONFIG_LOG_FRONTEND_OPT_API=y
CONFIG_LOG_INFO_COLOR_GREEN=y
CONFIG_LOG_DBG_COLOR_BLUE=y
CONFIG_LOG_OUTPUT_FORMAT_LINUX_TIMESTAMP=y
```

## nrf9160dk_nrf9160.overlay
```dts
// To get started, press Ctrl+Space to bring up the completion menu and view the available nodes.

// You can also use the buttons in the sidebar to perform actions on nodes.
// Actions currently available include:

// * Enabling / disabling the node
// * Adding the bus to a bus
// * Removing the node
// * Connecting ADC channels

// For more help, browse the DeviceTree documentation at https://docs.zephyrproject.org/latest/guides/dts/index.html
// You can also visit the nRF DeviceTree extension documentation at https://docs.nordicsemi.com/bundle/nrf-connect-vscode/page/guides/ncs_configure_app.html#devicetree-support-in-the-extension

&uart0 {
	current-speed = <115200>;
};

&wdt {
	status = "disabled";
	zephyr,deferred-init;
};
```

## src/main.c
```c
/*
 * Copyright (c) 2012-2014 Wind River Systems, Inc.
 *
 * SPDX-License-Identifier: Apache-2.0
 */

#include <zephyr/kernel.h>
#include <zephyr/logging/log.h>

LOG_MODULE_REGISTER(main,LOG_LEVEL_DBG);

int main(void)
{
	float f = 3.14;
	LOG_INF("Hello World! %s\r\n", CONFIG_BOARD);
	LOG_INF("float value is %0.2f\r\n", f);
	LOG_ERR("This is an error message");
	LOG_WRN("This is a warning message");
	LOG_INF("This is an info message");
	LOG_DBG("This is a debug message");
	return 0;
}
```
