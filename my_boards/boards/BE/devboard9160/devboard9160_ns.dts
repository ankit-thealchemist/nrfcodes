/dts-v1/;
#include <nordic/nrf9160ns_sica.dtsi>
#include "devboard9160-pinctrl.dtsi"
#include "devboard9160-partitioning.dtsi"

/ {
	chosen {
		zephyr,flash = &flash0;
		zephyr,sram = &sram0_ns;
		zephyr,code-partition = &slot0_ns_partition;
	};
};
