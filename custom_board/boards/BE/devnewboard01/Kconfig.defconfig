## led_pwm/boards/BE/devboard9160/board.yml
```yaml
board:
  name: devboard9160
  vendor: BE
  socs:
  - name: nrf9160
    variants:
    - name: ns
```

## led_pwm/boards/devboard02/Kconfig.devboard02
```kconfig
# DevBoard02 NRF9160 board configuration

# Copyright (c) 2018-2020 Nordic Semiconductor ASA
# SPDX-License-Identifier: Apache-2.0

config BOARD_DEVBOARD02
	select SOC_NRF9160_SICA if BOARD_DEVBOARD02_NRF9160 || BOARD_DEVBOARD02_NRF9160_NS
	select SOC_NRF52840_QIAA if BOARD_DEVBOARD02_NRF52840
```

## my_boards/boards/devboard02/dts/bindings/nordic,nrf9160dk-optional-routing.yaml
```yaml
# Copyright 2021 Nordic Semiconductor ASA
# SPDX-License-Identifier: Apache-2.0

description: DevBoard02 optional routing provided by analog switch

compatible: "nordic,devboard02-optional-routing"

include: base.yaml

properties:
  status:
    required: true

  control-gpios:
    type: phandle-array
    required: true
    description: |
      GPIO to use to control the analog switch.
```
